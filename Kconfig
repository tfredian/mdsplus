## Kconfig
```kconfig
#
# For a description of the syntax of this configuration file,
# see Documentation/kbuild/kconfig-language.txt.
#
mainmenu "Mdsplus building Configuration"

config EXAMPLE_ENABLE_VAR
	bool "Set a example enable variable"

config EXAMPLE_STRENTRY
	string "get value for EXAMPLE_STRENTRY"





# //////////////////////////////////////////////////////////////////////////// #
# //  DOCKER  //////////////////////////////////////////////////////////////// #
# //////////////////////////////////////////////////////////////////////////// #

config ENABLE_DOCKER
        bool "Enable docker build"

menu   DOCKER_BUILD
        # prompt "Configure docker build parameters"
        depends on ENABLE_DOCKER

  choice DOCKER_BUILD
        prompt "Select the docker build method"
        depends on ENABLE_DOCKER
        config WITH_DOCKER_IMAGE
         bool "Pull docker image"
        config WITH_DOCKER_CONTAINER
         bool "Start existing docker container"
        config WITH_DOCKER_URL
         bool "Create from url with a Dockerfile"
  endchoice

  config DOCKER_IMAGE
        string "Docker image"
        depends on ENABLE_DOCKER
        depends on WITH_DOCKER_IMAGE
        default "mdsplus/docker:build_fc22"

  config DOCKER_CONTAINER
        string "Container name or ID"
        depends on ENABLE_DOCKER
        depends on WITH_DOCKER_CONTAINER

  config DOCKER_URL
        string "Url"
        depends on ENABLE_DOCKER
        depends on WITH_DOCKER_URL
        default "."

endmenu # DOCKER_BUILD



# subdirectories
# source "..."
```
